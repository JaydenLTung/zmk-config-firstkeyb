/ {
    chosen {
        zmk,kscan = &kscan0;
    };

    kscan0: kscan {
        compatible = "zmk,kscan-gpio-matrix";

        diode-direction = "col2row";

        row-gpios
            = <&pro_micro 24 GPIO_ACTIVE_HIGH>
            , <&pro_micro 22 GPIO_ACTIVE_HIGH>
            , <&pro_micro 20 GPIO_ACTIVE_HIGH>
            ;

        col-gpios
            = <&pro_micro 104 GPIO_ACTIVE_HIGH>
            , <&pro_micro 100 GPIO_ACTIVE_HIGH>
            , <&pro_micro 29 GPIO_ACTIVE_HIGH>
            , <&pro_micro 115 GPIO_ACTIVE_HIGH>
            , <&pro_micro 113 GPIO_ACTIVE_HIGH>
            , <&pro_micro 111 GPIO_ACTIVE_HIGH>
            ;
    };
};