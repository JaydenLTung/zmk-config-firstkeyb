## boards/shields/uni5817/Kconfig.shield
```kconfig
config SHIELD_UNI5817_LEFT
    def_bool $(shields_list_contains,uni5817_left)

config SHIELD_UNI5817_RIGHT
    def_bool $(shields_list_contains,uni5817_right)

config SHIELD_UNI5817_DONGLE
    def_bool $(shields_list_contains,uni5817_dongle)
```
